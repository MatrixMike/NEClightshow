//--------------------------------------------------------------------------
//           - uPD78F0066.xcl -
//
//  NEC 78K0 microcontroller device uPD78F0066.
//
//  XLINK command file template.
//
//  Df0066.H created from device file df0066.78k [V1.00]
//  XCL file generator E2.03a
//--------------------------------------------------------------------------

//--------------------------------------------------------------------------
// Define CPU.
//--------------------------------------------------------------------------
-c78000

//--------------------------------------------------------------------------
// Allocate interrupt vector segment.
//--------------------------------------------------------------------------
-Z(CODE)INTVEC=0000-003F

//--------------------------------------------------------------------------
// Allocate CALLT segments.
//--------------------------------------------------------------------------
-Z(CODE)FLIST,IFLIST=0040-007F

//--------------------------------------------------------------------------
// Allocate CALLF segment.
//
// Note: This entry is necessary to avoid XLINK warnings.
//       If this segment is in use, adjustments to program code
//       allocation will be necessary!
//--------------------------------------------------------------------------
-Z(CODE)FCODE=0800-0FFF

//--------------------------------------------------------------------------
// Allocate program code segments.
//--------------------------------------------------------------------------
-Z(CODE)RCODE,CODE,CONST,CSTR,CCSTR,CDATA0,CDATA1,CDATA2=0080-BFFF

//--------------------------------------------------------------------------
// Allocate internal extended RAM segment.
//
// Note: This segment will not be automatically created by ICC78000/A78000
//       and it will not be initialised by CSTARTUP!
//--------------------------------------------------------------------------
-Z(DATA)IXRAM=E800-F7FF

//--------------------------------------------------------------------------
// Allocate program data segments.
//--------------------------------------------------------------------------
-Z(DATA)CSTACK+80,NO_INIT,IDATA2,UDATA2,ECSTR,TEMP=FB00-FE1F

//--------------------------------------------------------------------------
// Allocate saddr data segments.
//--------------------------------------------------------------------------
-Z(DATA)WRKSEG,IDATA0,IDATA1,UDATA0,UDATA1=FE20-FEDF

//--------------------------------------------------------------------------
// Allocate bit segment.
//--------------------------------------------------------------------------
-Z(BIT)BITVARS=0000

//--------------------------------------------------------------------------
// Select the printf/scanf formatter.
//--------------------------------------------------------------------------
-e_small_write=_formatted_write
-e_medium_read=_formatted_read

//--------------------------------------------------------------------------
// Select the 'C' library.
//--------------------------------------------------------------------------
cl7801s

//--------------------------------------------------------------------------
// Select the output file format.
//--------------------------------------------------------------------------
//-Fxcoff78k

//--------------------------------------------------------------------------
// Select the format modifier for XCOFF.
//--------------------------------------------------------------------------
-ysp
