//--------------------------------------------------------------------------
//           - uPD78F0066.xcl -
//
//  NEC 78K0 microcontroller device uPD78F0066.
//
//  XLINK command file to generate Intel-Hex File for Download 
//  to starterkit 78K Test - it
//--------------------------------------------------------------------------

//--------------------------------------------------------------------------
// Define CPU.
//--------------------------------------------------------------------------
-c78000

//--------------------------------------------------------------------------
// All ROM Segments have an offset of E800 against the ROM segments of the
// real device. The monitor program will download the application into the 
// extension RAM of the µPD78F0066. After the complete download the application
// will be started automatically
//--------------------------------------------------------------------------

//--------------------------------------------------------------------------
// Allocate interrupt vector segment.
//--------------------------------------------------------------------------
-Z(CODE)INTVEC=E800-E83F

//--------------------------------------------------------------------------
// Allocate CALLT segments.
//--------------------------------------------------------------------------
-Z(CODE)FLIST,IFLIST=E840-E87F

//--------------------------------------------------------------------------
// Allocate program code segments.
//--------------------------------------------------------------------------
-Z(CODE)RCODE,CODE,FCODE,CONST,CSTR,CCSTR,CDATA0,CDATA1,CDATA2=E880-F7FF

//--------------------------------------------------------------------------
// Allocate program data segments.
//--------------------------------------------------------------------------
-Z(DATA)CSTACK+80,NO_INIT,IDATA2,UDATA2,ECSTR,TEMP=FB00-FE1F

//--------------------------------------------------------------------------
// Allocate saddr data segments.
//--------------------------------------------------------------------------
-Z(DATA)WRKSEG,IDATA0,IDATA1,UDATA0,UDATA1=FE20-FEDF

//--------------------------------------------------------------------------
// Allocate bit segment.
//--------------------------------------------------------------------------
-Z(BIT)BITVARS=0000

//--------------------------------------------------------------------------
// Select the printf/scanf formatter.
//--------------------------------------------------------------------------
-e_small_write=_formatted_write
-e_medium_read=_formatted_read

//--------------------------------------------------------------------------
// Select the 'C' library.
//--------------------------------------------------------------------------
cl7801s

//--------------------------------------------------------------------------
// Select the output file format.
//--------------------------------------------------------------------------
//-FNEC2     // selected in the Embedded Workbench

//--------------------------------------------------------------------------
// Fillup unused memory addresses in the area E800 - F7FF
//--------------------------------------------------------------------------
-h(CODE)E800-F7FF
